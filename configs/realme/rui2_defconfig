## configs/realme/rui2_defconfig
```kconfig
CONFIG_APP_ADDRESS=0x4C4248AC
CONFIG_BOOTLOADER_BASE=0x4C400000
CONFIG_BOOTLOADER_SIZE=0x104654
CONFIG_BOOTMODE_ADDRESS=0x4C50752C
CONFIG_DPRINTF_ADDRESS=0x4C430B14
CONFIG_FASTBOOT_FAIL_ADDRESS=0x4C4253A0
CONFIG_FASTBOOT_INFO_ADDRESS=0x4C425320
CONFIG_FASTBOOT_OKAY_ADDRESS=0x4C42556C
CONFIG_FASTBOOT_PUBLISH_ADDRESS=0x4C424FAC
CONFIG_FASTBOOT_REGISTER_ADDRESS=0x4C424F70
CONFIG_FREE_ADDRESS=0x4C430F44
CONFIG_INIT_STORAGE_ADDRESS=0x4C402798
CONFIG_INIT_STORAGE_CALLER=0x4C402A42
CONFIG_LK_LOG_STORE_ADDRESS=0x4C443414
CONFIG_MALLOC_ADDRESS=0x4C431810
CONFIG_MEDIATEK_MT6768=y
CONFIG_MTK_DETECT_KEY_ADDRESS=0x4C404884
CONFIG_PARTITION_GET_SIZE_BY_NAME_ADDRESS=0x4C449A60
CONFIG_PARTITION_READ_ADDRESS=0x4C44ABE8
CONFIG_PLATFORM_INIT_ADDRESS=0x4C402A0C
CONFIG_PLATFORM_INIT_CALLER=0x4C42050C
CONFIG_REALME_RUI2=y
CONFIG_THREAD_CREATE_ADDRESS=0x4C420CC8
CONFIG_THREAD_RESUME_ADDRESS=0x4C420EDC
CONFIG_VIDEO_PRINTF_ADDRESS=0x4C430824
```
